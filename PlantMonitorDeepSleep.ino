#define BLYNK_PRINT Serial		// Comment this out to disable prints and save space
#define DEBUG 1					// Comment this out to disable terminal prints

#include <BlynkSimpleEsp8266.h>

#define AIR_READING_LEVEL 1023
#define WATER_READING_LEVEL 770

char auth[] = "5f5229c643474fbab7c813ccce676cd4"; //insert here your token generated by Blynk

#define NUM_SAMPLES 3
#define SensorAnalog A0
#define SensorsPwr 5 // GPIO5
#define S0_Alarm 4 // GPIO4
#define S1_Alarm 12 // GPIO12
#define S2_Alarm 13 // GPIO13
#define MUX_Disable 0 // GPIO0
#define MUX_A 2  //GPIO2
#define MUX_B 14  //GPIO14
#define MUX_C 15  //GPIO15

#define V_SLEEP_LENGTH 0
const byte A_VPIN[3] = { 2, 3, 4 };		// the virtual pin numbering for the moisture sensor alarms (respectively 1, 2 and 3)
const byte S_VPIN[3] = { 5, 6, 7 };		// the virtual pin numbering for the moisture sensor analog inputs (respectively 1, 2 and 3)
const byte P_VPIN[3] = { 8, 9, 10 };	// the virtual pin numbering for the photo sensors analog inputs (respectively 1, 2 and 3)

#define V_SLEEP_LENGTH V0  // virtual pin 0 asigned to change sleep period
int SLEEP_LENGTH = 10; // the default sleep period


void setup()
{

  /* add setup code here */

  Serial.begin(74880); // See the connection status in Serial Monitor
  pinMode(SensorAnalog, INPUT);
  pinMode(S0_Alarm, INPUT);
  pinMode(S1_Alarm, INPUT);
  pinMode(S2_Alarm, INPUT);
  pinMode(SensorsPwr, OUTPUT);
  pinMode(MUX_Disable, OUTPUT);
  pinMode(MUX_A, OUTPUT);
  pinMode(MUX_B, OUTPUT);
  pinMode(MUX_C, OUTPUT);

  digitalWrite(SensorsPwr, LOW);
  digitalWrite(MUX_Disable, HIGH);

  Blynk.begin(auth, "Goldrake", "vaffanculoatecazzone"); //insert here your SSID and password

  while (Blynk.connect() == false) {
     //Wait until connected
     //Serial.print("x");
  }
  Blynk.run();

  readSensors();
   
  ESP.deepSleep(SLEEP_LENGTH * 1000000,WAKE_RF_DEFAULT);   //try the default mode
}

void loop()
{
}




// This function sends Arduino's up time every second to Virtual Pin (5).
// In the app, Widget's reading frequency should be set to PUSH. This means
// that you define how often to send data to Blynk App.
void readSensors()
{
  uint16_t moisture[3][NUM_SAMPLES];
  uint16_t photo[3][NUM_SAMPLES];
  byte alarm[3];
  digitalWrite(SensorsPwr, HIGH);
  digitalWrite(MUX_Disable, LOW);
  delay(100);
  alarm[0] = digitalRead(S0_Alarm);
  alarm[1] = digitalRead(S1_Alarm);
  alarm[2] = digitalRead(S2_Alarm);
  
  for (int i = 0; i< 3; i++) {
	  mux_select(i);
	  for (int y = 0; y < NUM_SAMPLES; y++) {
		  delay(10);
		  moisture[i][y] = analogRead(SensorAnalog);
	  }
  }

  for (int i = 0; i< 3; i++) {
	  mux_select(3+i);
	  for (int y = 0; y < NUM_SAMPLES; y++) {
		  delay(10);
		  photo[i][y] = analogRead(SensorAnalog);
	  }
  }

  digitalWrite(SensorsPwr, LOW);
  digitalWrite(MUX_Disable, HIGH);

  //average all samples
  float moisture_average[3], photo_average[3];

  for (int i = 0; i< 3; i++) {
	  moisture_average[i] = 0;
	  photo_average[i] = 0;
	  for (int y = 0; y < NUM_SAMPLES; y++) {
		  moisture_average[i] += moisture[i][y];
		  photo_average[i] += photo[i][y];
	  }
	  moisture_average[i] /= NUM_SAMPLES;
	  photo_average[i] /= NUM_SAMPLES;
  }



  for (int i = 0; i < 3; i++) {
	  Blynk.virtualWrite(A_VPIN[i], alarm[i] ? 255 : 0);
#if DEBUG >=1
	  Serial.print(A_VPIN[i]);
	  Serial.print(": ");
	  Serial.println(alarm[i]);
#endif
	  Blynk.virtualWrite(S_VPIN[i], moisture_average[i]);
#if DEBUG >=1
	  Serial.print(S_VPIN[i]);
	  Serial.print(": ");
	  Serial.println(moisture_average[i]);
#endif
	  Blynk.virtualWrite(P_VPIN[i], photo_average[i]);
#if DEBUG >=1
	  Serial.print(P_VPIN[i]);
	  Serial.print(": ");
	  Serial.println(photo_average[i]);
#endif
  }
  
}


void mux_select(byte val) {
	digitalWrite(MUX_A, val & 1);
	digitalWrite(MUX_B, (val & 2) >> 1);
	digitalWrite(MUX_C, (val & 4) >> 2);
	return;
}

BLYNK_WRITE(V_SLEEP_LENGTH) {
	SLEEP_LENGTH = param.asInt();
#if DEBUG >=1
	Serial.print("Blynk writing V0 = ");
	Serial.println(SLEEP_LENGTH);
#endif
}

BLYNK_READ(V_SLEEP_LENGTH)
{
	Blynk.virtualWrite(V_SLEEP_LENGTH, SLEEP_LENGTH);
#if DEBUG >=1
	Serial.print("Blynk reading V0 = ");
	Serial.println(SLEEP_LENGTH);
#endif
}

BLYNK_CONNECTED() {
	Blynk.syncVirtual(V_SLEEP_LENGTH);
}